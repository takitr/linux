## arch/arm/configs/meson8_defconfig
```kconfig
CONFIG_EXPERIMENTAL=y
CONFIG_KERNEL_LZMA=y
CONFIG_SYSVIPC=y
CONFIG_NO_HZ=y
CONFIG_HIGH_RES_TIMERS=y
CONFIG_BSD_PROCESS_ACCT=y
CONFIG_IKCONFIG=y
CONFIG_IKCONFIG_PROC=y
CONFIG_BLK_DEV_INITRD=y
CONFIG_KALLSYMS_ALL=y
CONFIG_EMBEDDED=y
CONFIG_PROFILING=y
CONFIG_KPROBES=y
CONFIG_MODULES=y
CONFIG_MODULE_UNLOAD=y
CONFIG_ARCH_MESON8=y
CONFIG_MESON_LEGACY_REGISTER_API=y
CONFIG_ARM_ERRATA_751472=y
CONFIG_ARM_ERRATA_754322=y
CONFIG_AEABI=y
CONFIG_HIGHMEM=y
# CONFIG_COMPACTION is not set
CONFIG_VFP=y
CONFIG_NEON=y
CONFIG_BINFMT_MISC=y
# CONFIG_SUSPEND is not set
CONFIG_I2C_AML=y
# CONFIG_AML_RTC is not set
# CONFIG_MESON_INPUT_REMOTE is not set
# CONFIG_MESON_INPUT_KEYBOARD is not set
CONFIG_EFUSE=y
CONFIG_AML_NEXT_GEN_NAND=y
# CONFIG_AMAUDIO is not set
# CONFIG_AM_LCD_OUTPUT is not set
CONFIG_FB_AM=y
CONFIG_UEVENT_HELPER_PATH="/sbin/hotplug"
CONFIG_DEVTMPFS=y
CONFIG_DEVTMPFS_MOUNT=y
CONFIG_PROC_DEVICETREE=y
CONFIG_OF_SELFTEST=y
# CONFIG_BLK_DEV is not set
# CONFIG_INPUT_MOUSEDEV is not set
# CONFIG_INPUT_KEYBOARD is not set
# CONFIG_INPUT_MOUSE is not set
CONFIG_SERIO_LIBPS2=y
CONFIG_DEVPTS_MULTIPLE_INSTANCES=y
# CONFIG_HWMON is not set
CONFIG_SOUND=y
CONFIG_SND=y
CONFIG_SND_SOC=y
# CONFIG_HID is not set
# CONFIG_USB_SUPPORT is not set
CONFIG_MMC=y
# CONFIG_IOMMU_SUPPORT is not set
# CONFIG_FILE_LOCKING is not set
# CONFIG_DNOTIFY is not set
# CONFIG_INOTIFY_USER is not set
CONFIG_ISO9660_FS=y
CONFIG_JOLIET=y
CONFIG_ZISOFS=y
CONFIG_UDF_FS=y
CONFIG_MSDOS_FS=y
CONFIG_VFAT_FS=y
CONFIG_TMPFS=y
CONFIG_CRAMFS=y
CONFIG_NLS_CODEPAGE_437=y
CONFIG_NLS_ISO8859_1=y
CONFIG_PRINTK_TIME=y
CONFIG_MAGIC_SYSRQ=y
CONFIG_READABLE_ASM=y
CONFIG_DEBUG_SECTION_MISMATCH=y
CONFIG_SCHEDSTATS=y
CONFIG_TIMER_STATS=y
CONFIG_DEBUG_MUTEXES=y
CONFIG_DEBUG_INFO=y
CONFIG_FUNCTION_TRACER=y
CONFIG_CRYPTO_AUTHENC=y
CONFIG_CRYPTO_CBC=y
CONFIG_CRYPTO_ECB=y
CONFIG_CRYPTO_HMAC=y
CONFIG_CRYPTO_MD5=y
CONFIG_CRYPTO_SHA1=y
CONFIG_CRYPTO_SHA256=y
CONFIG_CRYPTO_AES=y
CONFIG_CRYPTO_ARC4=y
CONFIG_CRYPTO_DES=y
CONFIG_CRYPTO_DEFLATE=y
CONFIG_CRC_CCITT=y
CONFIG_CRC16=y
CONFIG_CRC_T10DIF=y
CONFIG_CRC7=y
CONFIG_LIBCRC32C=y
CONFIG_AVERAGE=y
```

## drivers/amlogic/amlnf/Kconfig
```kconfig
#
# Amlogic NAND device configuration
#

menu "Meson NAND Device Support(For NEXT GEN NAND DRIV)"

config AML_NEXT_GEN_NAND
	bool "Meson NAND flash device(Next gen driver)"
	default n
	help
	  Support for NAND flash on Amlogic Meson platforms for Next gen driver


config AML_NAND_ENV
	bool "Meson NAND environment variable device (dev/nand_env) support"
	depends on AM_NAND
	depends on ARCH_MESON3 || ARCH_MESON6
	default y
	help
	  Support NAND environment variable device

config AML_NAND_KEY
	bool "Meson key data store in nand device(dev/nand_key) support"
	depends on AML_NEXT_GEN_NAND
	depends on ARCH_MESON3 || ARCH_MESON6
	default n
	help
	  Support   key variable store in NAND device

config SECURE_NAND
	bool "Meson secure data store in nand device support"
	depends on AML_NEXT_GEN_NAND
	depends on ARCH_MESON3 || ARCH_MESON6
	default n
	help
	  Support  secure storage in NAND device

endmenu
        
```

## drivers/amlogic/gpu/umplock/Kconfig
```kconfig
config UMPLOCK
        tristate "UMPLOCK support"
        default n
        ---help---
		Mali UMPLOCK Support
```

## drivers/amlogic/mmc/Kconfig
```kconfig
#
# MMC/SD host controller drivers
#

comment "MMC/SD/SDIO Host Controller Drivers"

menu "Multimedia Card support"

config MMC_AML
	bool "Amlogic Multimedia Card support"
	default n
	select MMC
	select MMC_BLOCK
	select MMC_BLOCK_BOUNCE
	
endmenu
```

## drivers/amlogic/wifi/Kconfig
```kconfig
menuconfig AM_WIFI
	bool "WiFi support"
	default n

if AM_WIFI
config AM_WIFI_SD_MMC
	bool "Amlogic SDIO Wi-Fi support"
	depends on AM_WIFI
	default n

config AM_WIFI_USB
	bool "Amlogic USB Wi-Fi Dongle Support"
	depends on AM_WIFI
	default n


source "../hardware/wifi/broadcom/drivers/ap6xxx/broadcm_40181/Kconfig"
source "../hardware/wifi/realtek/drivers/8188eu/rtl8xxx_EU/Kconfig"
source "../hardware/wifi/realtek/drivers/8188eu/rtl8xxx_EU_MP/Kconfig"
source "../hardware/wifi/realtek/drivers/8192cu/rtl8xxx_CU/Kconfig"
source "../hardware/wifi/realtek/drivers/8192du/rtl8xxx_DU/Kconfig"
source "../hardware/wifi/realtek/drivers/8192eu/rtl8192EU/Kconfig"

endif # AM_WIFI
```
